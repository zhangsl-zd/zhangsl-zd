## Documentation/devicetree/bindings/gpu/phytium-display.txt
```
* Phytium Display Engine

Required properties:
  - compatible : value should be "phytium,dc".
  - reg : Physical base address of the registers and length of memory
	  mapped region.
  - interrupts : interrupt number.
  - pipe_mask : specify which pipe is enabled, each bit corresponds to a pipe.
  - edp_mask : specify which pipe is edp port, each bit corresponds to a pipe (0:dp, 1:edp).

Example:
	dc0@32000000 {
		compatible = "phytium,dc";
		reg = <0x0 0x32000000 0x0 0x8000>;
		interrupts = <GIC_SPI 44 IRQ_TYPE_LEVEL_HIGH>;
		pipe_mask = 0x3
		edp_mask = 0x0;
	};
```

## drivers/net/can/phytium_canfd/Kconfig
```kconfig
# SPDX-License-Identifier: GPL-2.0-only
config CANFD_PHYTIUM
	tristate "Phytium CANFD support"
	default y if ARCH_PHYTIUM
	help
	  Say Y here if you want support for Phytium CANFD controller framework.
	  This is common support for devices that embed the Phytium CAN IP.

	  To compile this driver as a module, choose M here: the module will
	  be called phytium_can.

config CANFD_PHYTIUM_PLATFORM
	tristate "Phytium CANFD support for io-mapped devices"
	default y if ARCH_PHYTIUM
	depends on HAS_IOMEM && CANFD_PHYTIUM
	help
	  Say Y here is you want to support for IO Mapped Phytium CANFD controller.
	  This support is for devices that have the Phytium CANFD controller IP
	  embedded into the device and the IP is IO Mapped to the processor.

	  To compile this driver as a module, choose M here: the module will
	  be called phytium_can_platform.
```

## drivers/usb/phytium/Kconfig
```kconfig
config USB_PHYTIUM
	tristate "PHYTIUM USB DRD Core Support"
	depends on USB
	help
	  Say Y or M here if your system has a OTG USB Controller based on PHYTIUM USB Core.

	  If you choose to build this driver is a dynamically linked modules, the module will
          be called phytium-usb.ko

config USB_PHYTIUM_HOST
	tristate "Host only mode"
	depends on USB=y && (USB_PHYTIUM=m || USB_PHYTIUM)
	help
	  Say Y or M here if your want to set PHYTIUM OTG USB Controller work in Host-only mode

config USB_PHYTIUM_GADGET
	tristate "Gadget only mode"
	depends on USB_GADGET=y && (USB_PHYTIUM=m || USB_PHYTIUM)
	help
	  Say Y or M here if your want to set PHYTIUM OTG USB Controller work in Peripheral-only mode
```
